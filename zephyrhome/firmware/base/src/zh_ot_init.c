/* SPDX-License-Identifier: Apache-2.0 */
/*
 * OpenThread initialization for ZephyrHome.
 * Network credentials come from Kconfig symbols generated by the CLI:
 *   CONFIG_ZH_OT_CHANNEL, CONFIG_ZH_OT_PANID,
 *   CONFIG_ZH_OT_NETWORK_NAME, CONFIG_ZH_OT_NETWORK_KEY
 */
#include "zh_ot_init.h"
#include <zephyr/logging/log.h>
#include <zephyr/net/openthread.h>
#include <openthread/thread.h>
#include <openthread/dataset_ftd.h>
#include <string.h>

LOG_MODULE_REGISTER(zh_ot_init, LOG_LEVEL_INF);

static zh_network_ready_cb g_ready_cb;

/* ── Network key: convert hex string CONFIG → bytes at runtime ─────────── */
static void hex_str_to_bytes(const char *hex, uint8_t *out, size_t len)
{
	for (size_t i = 0; i < len; i++) {
		char hi = hex[i * 2];
		char lo = hex[i * 2 + 1];
		uint8_t h = (hi >= 'a') ? (hi - 'a' + 10) :
			    (hi >= 'A') ? (hi - 'A' + 10) : (hi - '0');
		uint8_t l = (lo >= 'a') ? (lo - 'a' + 10) :
			    (lo >= 'A') ? (lo - 'A' + 10) : (lo - '0');
		out[i] = (h << 4) | l;
	}
}

static void ot_dataset_init(otInstance *ot)
{
	otOperationalDataset ds = {};

	ds.mChannel = CONFIG_ZH_OT_CHANNEL;
	ds.mComponents.mIsChannelPresent = true;

	ds.mPanId = CONFIG_ZH_OT_PANID;
	ds.mComponents.mIsPanIdPresent = true;

	strncpy(ds.mNetworkName.m8, CONFIG_ZH_OT_NETWORK_NAME,
		OT_NETWORK_NAME_MAX_SIZE);
	ds.mComponents.mIsNetworkNamePresent = true;

	hex_str_to_bytes(CONFIG_ZH_OT_NETWORK_KEY,
			 ds.mNetworkKey.m8, OT_NETWORK_KEY_SIZE);
	ds.mComponents.mIsNetworkKeyPresent = true;

	otDatasetSetActive(ot, &ds);
}

static void ot_state_changed_cb(otChangedFlags flags, void *ctx)
{
	ARG_UNUSED(ctx);

	if (!(flags & OT_CHANGED_THREAD_ROLE)) {
		return;
	}

	otInstance *ot = openthread_get_default_instance();
	otDeviceRole role = otThreadGetDeviceRole(ot);

	LOG_INF("Thread role: %s", otThreadDeviceRoleToString(role));

	if ((role == OT_DEVICE_ROLE_CHILD || role == OT_DEVICE_ROLE_ROUTER)
	    && g_ready_cb) {
		g_ready_cb();
	}
}

void zh_ot_init(zh_network_ready_cb ready_cb)
{
	g_ready_cb = ready_cb;

	otInstance *ot = openthread_get_default_instance();

	openthread_api_mutex_lock(openthread_get_default_context());

	ot_dataset_init(ot);
	otSetStateChangedCallback(ot, ot_state_changed_cb, NULL);
	otLinkSetPollPeriod(ot, CONFIG_OPENTHREAD_POLL_PERIOD);
	otIp6SetEnabled(ot, true);
	otThreadSetEnabled(ot, true);

	openthread_api_mutex_unlock(openthread_get_default_context());

	LOG_INF("OpenThread started (MTD-SED, channel=%d, pan=0x%04X, poll=%d ms)",
		CONFIG_ZH_OT_CHANNEL, CONFIG_ZH_OT_PANID,
		CONFIG_OPENTHREAD_POLL_PERIOD);
}
