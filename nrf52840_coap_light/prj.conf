## CMakeLists.txt
```
cmake_minimum_required(VERSION 3.20.0)

find_package(Zephyr REQUIRED HINTS $ENV{ZEPHYR_BASE})
project(coap_light_button)

target_sources(app PRIVATE
    src/main.c
    src/coap_utils.c
)

target_include_directories(app PRIVATE src)
```

## prj.conf
```kconfig
# ── Networking ───────────────────────────────────────────────────────────────
CONFIG_NETWORKING=y
CONFIG_NET_UDP=y
CONFIG_NET_IPV6=y
CONFIG_NET_IPV6_NBR_CACHE=n
CONFIG_NET_IPV6_MLD=n

# ── OpenThread (Minimal Thread Device = lower power than FTD) ────────────────
CONFIG_NET_L2_OPENTHREAD=y
CONFIG_OPENTHREAD_MTD=y
CONFIG_OPENTHREAD_MTD_SED=y          # Sleepy End Device: radio off between polls
CONFIG_OPENTHREAD_POLL_PERIOD=5000   # ms – wake parent every 5 s to check mail
CONFIG_OPENTHREAD_MANUAL_START=n
CONFIG_OPENTHREAD_THREAD_STACK_SIZE=3072

# ── CoAP ─────────────────────────────────────────────────────────────────────
CONFIG_COAP=y
CONFIG_COAP_LOG_LEVEL_WRN=y

# ── GPIO / Buttons / LEDs ────────────────────────────────────────────────────
CONFIG_GPIO=y
CONFIG_DK_LIBRARY=y

# ── Power Management ──────────────────────────────────────────────────────────
CONFIG_PM=y
CONFIG_PM_DEVICE=y
CONFIG_PM_DEVICE_RUNTIME=y

# ── System ───────────────────────────────────────────────────────────────────
CONFIG_REBOOT=y
CONFIG_ASSERT=y

# ── Logging ───────────────────────────────────────────────────────────────────
CONFIG_LOG=y
CONFIG_LOG_DEFAULT_LEVEL=3           # INFO
CONFIG_OPENTHREAD_LOG_LEVEL_WARNING=y
CONFIG_NET_LOG=n

# ── Stack / heap ─────────────────────────────────────────────────────────────
CONFIG_MAIN_STACK_SIZE=4096
CONFIG_SYSTEM_WORKQUEUE_STACK_SIZE=2048
```

## boards/nrf52840dk_nrf52840.conf
```kconfig
# nRF52840 DK 보드 전용 추가 설정

# USB CDC 시리얼 (디버그용 – 배포 시 제거하면 ~0.5 mA 절약)
CONFIG_USB_DEVICE_STACK=y
CONFIG_USB_CDC_ACM=y
CONFIG_UART_LINE_CTRL=y

# 온칩 플래시 절전
CONFIG_SOC_FLASH_NRF_UICR_APPROTECT_DISABLE=y
```

## boards/nrf52840dk_nrf52840.overlay
```dts
/*
 * nRF52840 DK 핀 오버레이
 *
 * 버튼 1 (SW0) → P0.11  : CoAP ON 요청
 * 버튼 2 (SW1) → P0.12  : CoAP OFF 요청
 * LED   1      → P0.13  : 로컬 상태 표시
 */

/ {
    chosen {
        zephyr,console = &cdc_acm_uart0;
        zephyr,shell-uart = &cdc_acm_uart0;
    };
};

&zephyr_udc0 {
    cdc_acm_uart0: cdc_acm_uart0 {
        compatible = "zephyr,cdc-acm-uart";
    };
};
```

## src/main.c
```c
#include <zephyr/kernel.h>
#include <zephyr/logging/log.h>
#include <zephyr/net/openthread.h>
#include <openthread/thread.h>
#include <openthread/dataset_ftd.h>

#include <dk_buttons_and_leds.h>

#include "coap_utils.h"

LOG_MODULE_REGISTER(main, LOG_LEVEL_INF);

/* ── Thread 네트워크 자격 증명 (실제 배포 시 변경) ──────────────────────────
 * 동일 네트워크에 속한 CoAP 서버와 같은 값을 사용해야 합니다.
 * openthread CLI → dataset init new / dataset commit active 로 생성 가능.
 * ─────────────────────────────────────────────────────────────────────────── */
#define OT_CHANNEL       15
#define OT_PANID         0xABCD
#define OT_NETWORK_NAME  "CoAPLight"
/* 16-byte master key (hex) */
static const uint8_t OT_NETWORK_KEY[OT_NETWORK_KEY_SIZE] = {
    0x00, 0x11, 0x22, 0x33, 0x44, 0x55, 0x66, 0x77,
    0x88, 0x99, 0xaa, 0xbb, 0xcc, 0xdd, 0xee, 0xff
};

/* ── CoAP 서버 주소 ─────────────────────────────────────────────────────────
 * NULL → 멀티캐스트(ff03::1)로 브로드캐스트
 * 실제 서버 주소 예: "fd12:3456:789a::1"
 * ─────────────────────────────────────────────────────────────────────────── */
#define COAP_SERVER_ADDR  NULL

/* ── 스레드 및 세마포어 ──────────────────────────────────────────────────── */
#define RX_THREAD_STACK   1536
#define RX_THREAD_PRIO    5

K_THREAD_STACK_DEFINE(rx_stack, RX_THREAD_STACK);
static struct k_thread rx_thread_data;

/* 버튼 이벤트를 rx 스레드로 전달 */
static K_SEM_DEFINE(button_sem, 0, 1);
static volatile light_cmd_t pending_cmd;

/* ── LED 상태 ────────────────────────────────────────────────────────────── */
static bool local_light_on;

/* ── Thread 네트워크 초기화 ─────────────────────────────────────────────── */
static void ot_dataset_init(otInstance *ot)
{
    otOperationalDataset ds = {};

    /* 채널 */
    ds.mChannel              = OT_CHANNEL;
    ds.mComponents.mIsChannelPresent = true;

    /* PAN ID */
    ds.mPanId                = OT_PANID;
    ds.mComponents.mIsPanIdPresent = true;

    /* 네트워크 이름 */
    strncpy(ds.mNetworkName.m8, OT_NETWORK_NAME,
            OT_NETWORK_NAME_MAX_SIZE);
    ds.mComponents.mIsNetworkNamePresent = true;

    /* 네트워크 키 */
    memcpy(ds.mNetworkKey.m8, OT_NETWORK_KEY, OT_NETWORK_KEY_SIZE);
    ds.mComponents.mIsNetworkKeyPresent = true;

    otDatasetSetActive(ot, &ds);
}

static void ot_state_changed_cb(otChangedFlags flags, void *ctx)
{
    ARG_UNUSED(ctx);
    otInstance *ot = openthread_get_default_instance();

    if (flags & OT_CHANGED_THREAD_ROLE) {
        otDeviceRole role = otThreadGetDeviceRole(ot);
        LOG_INF("Thread role: %s", otThreadDeviceRoleToString(role));

        /* 네트워크 합류 후 CoAP 초기화 */
        if (role == OT_DEVICE_ROLE_CHILD ||
            role == OT_DEVICE_ROLE_ROUTER) {
            if (coap_utils_init() != 0) {
                LOG_ERR("CoAP init failed");
            }
        }
    }
}

static void ot_init(void)
{
    otInstance *ot = openthread_get_default_instance();

    openthread_api_mutex_lock(openthread_get_default_context());

    ot_dataset_init(ot);
    otSetStateChangedCallback(ot, ot_state_changed_cb, NULL);

    /* MTD-SED: poll period 설정 (저전력 핵심) */
    otLinkSetPollPeriod(ot, CONFIG_OPENTHREAD_POLL_PERIOD);

    otIp6SetEnabled(ot, true);
    otThreadSetEnabled(ot, true);

    openthread_api_mutex_unlock(openthread_get_default_context());

    LOG_INF("OpenThread started (MTD-SED, poll=%d ms)",
            CONFIG_OPENTHREAD_POLL_PERIOD);
}

/* ── 버튼 콜백 (ISR 컨텍스트) ───────────────────────────────────────────── */
static void button_handler(uint32_t button_state, uint32_t has_changed)
{
    if (has_changed & DK_BTN1_MSK && button_state & DK_BTN1_MSK) {
        pending_cmd = LIGHT_CMD_ON;
        k_sem_give(&button_sem);
    }
    if (has_changed & DK_BTN2_MSK && button_state & DK_BTN2_MSK) {
        pending_cmd = LIGHT_CMD_OFF;
        k_sem_give(&button_sem);
    }
    if (has_changed & DK_BTN3_MSK && button_state & DK_BTN3_MSK) {
        pending_cmd = LIGHT_CMD_TOGGLE;
        k_sem_give(&button_sem);
    }
}

/* ── RX / 이벤트 처리 스레드 ────────────────────────────────────────────── */
static void rx_thread_fn(void *a, void *b, void *c)
{
    ARG_UNUSED(a); ARG_UNUSED(b); ARG_UNUSED(c);

    while (true) {
        /*
         * 저전력 전략:
         * k_sem_take 에서 CPU 가 WFI(Wait-For-Interrupt) 슬립.
         * 버튼 인터럽트 또는 CoAP RX 타임아웃이 깨어날 때만 동작.
         */
        int ret = k_sem_take(&button_sem, K_MSEC(COAP_RX_TIMEOUT_MS));

        if (ret == 0) {
            /* 버튼 이벤트: CoAP 요청 전송 */
            light_cmd_t cmd = pending_cmd;
            LOG_INF("Button pressed → cmd=%d", cmd);
            coap_utils_light_request(COAP_SERVER_ADDR, cmd);

            /* 로컬 LED 즉시 반영 */
            if (cmd == LIGHT_CMD_ON) {
                local_light_on = true;
            } else if (cmd == LIGHT_CMD_OFF) {
                local_light_on = false;
            } else {
                local_light_on = !local_light_on;
            }
            dk_set_led(DK_LED1, local_light_on);
        }

        /* 수신 패킷 처리 (서버 역할) */
        coap_utils_process_rx();
    }
}

/* ── main ────────────────────────────────────────────────────────────────── */
int main(void)
{
    LOG_INF("=== CoAP Light Button (nRF52840, MTD-SED) ===");

    /* LED/버튼 초기화 */
    int ret = dk_buttons_and_leds_init(button_handler);
    if (ret) {
        LOG_ERR("dk_buttons_and_leds_init: %d", ret);
        return ret;
    }

    /* 시작 알림 LED */
    dk_set_led_on(DK_LED2);
    k_sleep(K_MSEC(300));
    dk_set_led_off(DK_LED2);

    /* OpenThread 시작 */
    ot_init();

    /* RX / 이벤트 스레드 시작 */
    k_thread_create(&rx_thread_data, rx_stack,
                    K_THREAD_STACK_SIZEOF(rx_stack),
                    rx_thread_fn, NULL, NULL, NULL,
                    RX_THREAD_PRIO, 0, K_NO_WAIT);
    k_thread_name_set(&rx_thread_data, "coap_rx");

    /*
     * main 스레드는 이후 사용하지 않으므로 종료.
     * Zephyr 스케줄러가 idle 스레드를 실행 → WFI → 저전력 상태 유지.
     */
    return 0;
}
```

## src/coap_utils.c
```c
#include <zephyr/kernel.h>
#include <zephyr/logging/log.h>
#include <zephyr/net/coap.h>
#include <zephyr/net/net_ip.h>
#include <zephyr/net/socket.h>
#include <zephyr/net/openthread.h>
#include <openthread/thread.h>

#include <dk_buttons_and_leds.h>
#include <string.h>

#include "coap_utils.h"

LOG_MODULE_REGISTER(coap_utils, LOG_LEVEL_INF);

/* ── 상수 ─────────────────────────────────────────────────────────────────── */
#define COAP_PORT          5683
#define COAP_BUF_SIZE      256
#define COAP_TOKEN_LEN     4
#define COAP_RX_TIMEOUT_MS 3000

/* Thread 멀티캐스트 – 모든 FTD/MTD 노드 */
#define OT_MESH_LOCAL_MCAST "ff03::1"

/* ── 내부 상태 ───────────────────────────────────────────────────────────── */
static int sock = -1;
static uint8_t coap_buf[COAP_BUF_SIZE];
static uint16_t msg_id;

/* ── 헬퍼: 소켓 열기/닫기 ────────────────────────────────────────────────── */
static int udp_socket_open(void)
{
    struct sockaddr_in6 bind_addr = {
        .sin6_family = AF_INET6,
        .sin6_port   = htons(COAP_PORT),
        .sin6_addr   = IN6ADDR_ANY_INIT,
    };

    int s = zsock_socket(AF_INET6, SOCK_DGRAM, IPPROTO_UDP);
    if (s < 0) {
        LOG_ERR("socket() failed: %d", errno);
        return -errno;
    }

    if (zsock_bind(s, (struct sockaddr *)&bind_addr, sizeof(bind_addr)) < 0) {
        LOG_ERR("bind() failed: %d", errno);
        zsock_close(s);
        return -errno;
    }

    return s;
}

/* ── 공개 API ────────────────────────────────────────────────────────────── */

int coap_utils_init(void)
{
    sock = udp_socket_open();
    if (sock < 0) {
        return sock;
    }
    msg_id = sys_rand32_get() & 0xFFFF;
    LOG_INF("CoAP socket ready (port %d)", COAP_PORT);
    return 0;
}

int coap_utils_light_request(const char *peer_addr, light_cmd_t cmd)
{
    struct coap_packet pkt;
    struct sockaddr_in6 dst = {
        .sin6_family = AF_INET6,
        .sin6_port   = htons(COAP_PORT),
    };

    /* 대상 주소 결정 */
    const char *addr_str = peer_addr ? peer_addr : OT_MESH_LOCAL_MCAST;
    if (zsock_inet_pton(AF_INET6, addr_str, &dst.sin6_addr) != 1) {
        LOG_ERR("Invalid peer address: %s", addr_str);
        return -EINVAL;
    }

    /* CoAP 패킷 구성 */
    uint8_t token[COAP_TOKEN_LEN];
    sys_rand_get(token, sizeof(token));

    int ret = coap_packet_init(&pkt, coap_buf, sizeof(coap_buf),
                               COAP_VERSION_1,
                               peer_addr ? COAP_TYPE_CON : COAP_TYPE_NON_CON,
                               COAP_TOKEN_LEN, token,
                               COAP_METHOD_PUT,
                               msg_id++);
    if (ret < 0) {
        LOG_ERR("coap_packet_init: %d", ret);
        return ret;
    }

    /* Uri-Path 옵션 */
    ret = coap_packet_append_option(&pkt, COAP_OPTION_URI_PATH,
                                    COAP_LIGHT_RESOURCE,
                                    strlen(COAP_LIGHT_RESOURCE));
    if (ret < 0) {
        LOG_ERR("append uri-path: %d", ret);
        return ret;
    }

    /* Content-Format: text/plain */
    uint8_t fmt = 0;
    ret = coap_packet_append_option(&pkt, COAP_OPTION_CONTENT_FORMAT,
                                    &fmt, sizeof(fmt));
    if (ret < 0) {
        LOG_ERR("append content-format: %d", ret);
        return ret;
    }

    /* payload */
    ret = coap_packet_append_payload_marker(&pkt);
    if (ret < 0) { return ret; }

    uint8_t payload = (uint8_t)cmd;
    ret = coap_packet_append_payload(&pkt, &payload, sizeof(payload));
    if (ret < 0) { return ret; }

    /* 전송 */
    ret = zsock_sendto(sock, pkt.data, pkt.offset, 0,
                       (struct sockaddr *)&dst, sizeof(dst));
    if (ret < 0) {
        LOG_ERR("sendto failed: %d", errno);
        return -errno;
    }

    LOG_INF("CoAP PUT → %s  cmd=%d  (%d bytes)", addr_str, cmd, pkt.offset);
    return 0;
}

/* ── 수신 처리 (서버 역할) ───────────────────────────────────────────────── */
static int light_put_handler(struct coap_resource *resource,
                              struct coap_packet *request,
                              struct sockaddr *addr, socklen_t addr_len)
{
    uint8_t payload[8];
    uint16_t payload_len = sizeof(payload);

    const uint8_t *p = coap_packet_get_payload(request, &payload_len);
    if (!p || payload_len == 0) {
        return -EINVAL;
    }

    light_cmd_t cmd = (light_cmd_t)p[0];
    LOG_INF("Received light cmd: %d", cmd);

    switch (cmd) {
    case LIGHT_CMD_ON:
        dk_set_led_on(DK_LED1);
        break;
    case LIGHT_CMD_OFF:
        dk_set_led_off(DK_LED1);
        break;
    case LIGHT_CMD_TOGGLE:
        dk_set_led(DK_LED1, !dk_get_buttons() /* 간이 토글 */);
        break;
    default:
        return -EINVAL;
    }

    /* 2.04 Changed 응답 */
    struct coap_packet rsp;
    uint8_t rsp_buf[64];
    uint8_t tok[COAP_TOKEN_LEN];
    uint8_t tok_len = coap_header_get_token(request, tok);

    int ret = coap_ack_init(&rsp, request, rsp_buf, sizeof(rsp_buf),
                            COAP_RESPONSE_CODE_CHANGED);
    if (ret < 0) { return ret; }

    return zsock_sendto(sock, rsp.data, rsp.offset, 0, addr, addr_len);
}

static const char * const light_path[] = { COAP_LIGHT_RESOURCE, NULL };

static struct coap_resource coap_resources[] = {
    {
        .path    = light_path,
        .put     = light_put_handler,
    },
    { }   /* sentinel */
};

void coap_utils_process_rx(void)
{
    if (sock < 0) { return; }

    struct zsock_pollfd fds = { .fd = sock, .events = ZSOCK_POLLIN };
    int ready = zsock_poll(&fds, 1, COAP_RX_TIMEOUT_MS);
    if (ready <= 0) { return; }

    struct sockaddr_in6 src;
    socklen_t src_len = sizeof(src);

    int len = zsock_recvfrom(sock, coap_buf, sizeof(coap_buf), 0,
                             (struct sockaddr *)&src, &src_len);
    if (len < 0) { return; }

    struct coap_packet pkt;
    if (coap_packet_parse(&pkt, coap_buf, len, NULL, 0) < 0) {
        LOG_WRN("CoAP parse failed");
        return;
    }

    int r = coap_handle_request(&pkt, coap_resources,
                                (struct sockaddr *)&src, src_len);
    if (r < 0 && r != -ENOENT) {
        LOG_WRN("coap_handle_request: %d", r);
    }
}
```

## src/coap_utils.h
```c
#ifndef COAP_UTILS_H_
#define COAP_UTILS_H_

#include <zephyr/net/coap.h>
#include <zephyr/net/net_ip.h>

/* CoAP 리소스 경로 */
#define COAP_LIGHT_RESOURCE   "light"
#define COAP_URI_PATH_MAX     32

/* 라이트 명령 */
typedef enum {
    LIGHT_CMD_ON  = 1,
    LIGHT_CMD_OFF = 0,
    LIGHT_CMD_TOGGLE = 2,
} light_cmd_t;

/**
 * @brief CoAP 서버/클라이언트 초기화
 * @return 0 성공, 음수 오류
 */
int coap_utils_init(void);

/**
 * @brief CoAP 라이트 PUT 요청 전송
 *
 * @param peer_addr  대상 서버 IPv6 주소 (문자열, NULL이면 멀티캐스트 ff03::1)
 * @param cmd        LIGHT_CMD_ON / OFF / TOGGLE
 * @return 0 성공, 음수 오류
 */
int coap_utils_light_request(const char *peer_addr, light_cmd_t cmd);

/**
 * @brief 수신 CoAP 패킷 처리 (rx thread에서 호출)
 */
void coap_utils_process_rx(void);

#endif /* COAP_UTILS_H_ */
```
